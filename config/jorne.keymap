/* Keyball39 ZMK Keymap */

#include <zmk/keymap.h>

/* Define the keymap layout for Keyball39 */
const struct zmk_keymap_layer keyball39_layers[] = {
    /* Default Layer */
    [0] = LAYER( 
        /* Row 1 */
        &kp A,  &kp B,  &kp C,  &kp D,  &kp E,   &none,   &kp F,  &kp G,  &kp H,  &kp I,  &kp J,
        /* Row 2 */
        &kp K,  &kp L,  &kp M,  &kp N,  &kp O,   &none,   &kp P,  &kp Q,  &kp R,  &kp S,  &kp T,
        /* Row 3 */
        &kp U,  &kp V,  &kp W,  &kp X,  &kp Y,   &none,   &kp Z,  &kp N1, &kp N2, &kp N3, &kp N4,
        /* Row 4 */
        &kp N5, &kp N6, &kp N7, &kp N8, &kp N9,  &kp N0,  &kp ENTER, &kp SPACE, &kp BSPC
    )
};
